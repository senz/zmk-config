## config/boards/shields/rev57lp/Kconfig.defconfig
```kconfig
# Copyright (c) 2020 The ZMK Contributors
# SPDX-License-Identifier: MIT

if SHIELD_REV57LP

config ZMK_KEYBOARD_NAME
    default "Rev57LP"

endif
```

## config/boards/shields/rev57lp/Kconfig.shield
```kconfig
# Copyright (c) 2020 The ZMK Contributors
# SPDX-License-Identifier: MIT

config SHIELD_REV57LP
    def_bool $(shields_list_contains,rev57lp)
```

## config/dasbob/Kconfig.defconfig
```kconfig
# Copyright (c) 2021 The ZMK Contributors
# SPDX-License-Identifier: MIT

if SHIELD_DASBOB_LEFT

config ZMK_KEYBOARD_NAME
	default "dasbob"

config ZMK_SPLIT_ROLE_CENTRAL
	default y

endif

if SHIELD_DASBOB_LEFT || SHIELD_DASBOB_RIGHT

config ZMK_SPLIT
	default y

endif
```

## config/dasbob/Kconfig.shield
```kconfig
# Copyright (c) 2021 The ZMK Contributors
# SPDX-License-Identifier: MIT

config SHIELD_DASBOB_LEFT
	def_bool $(shields_list_contains,dasbob_left)

config SHIELD_DASBOB_RIGHT
	def_bool $(shields_list_contains,dasbob_right)
```

## config/west.yml
```yaml
manifest:
  remotes:
    - name: zmkfirmware
      url-base: https://github.com/zmkfirmware
    # See https://docs.zephyrproject.org/3.2.0/develop/west/manifest.html#projects
  projects:
    - name: zmk
      remote: zmkfirmware
      revision: v0.2.1
      import: app/west.yml
  self:
    path: config
```
